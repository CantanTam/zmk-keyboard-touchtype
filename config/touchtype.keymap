#include <dt-bindings/zmk/keys.h>
#include <dt-bindings/zmk/bt.h>

/ {
    keymap {
        compatible = "zmk,keymap";

        default_layer {
            bindings = <
                &kp SPACE    /* 第一个 (也是唯一的) 按键: SPACE */
            >;
        };
    };
};