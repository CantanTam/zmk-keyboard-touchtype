## boards/arm/touchtype/Kconfig.defconfig
```kconfig
# touchtype board configuration
# 不影响蓝牙开关与否

if BOARD_TOUCHTYPE

config BOARD
	default "touchtype"

config BT_CTLR
	default BT

config ZMK_KEYBOARD_NAME
    default "touchModule"

config ZMK_KSCAN_MATRIX_POLLING
    default y

endif # BOARD_TOUCHTYPE
```

## boards/arm/touchtype/touchtype_defconfig
```kconfig
CONFIG_BOARD_TOUCHTYPE=y
CONFIG_SOC_SERIES_NRF52X=y
CONFIG_SOC_NRF52832_QFAA=y

# enable GPIO
CONFIG_GPIO=y

# Enable i2c
CONFIG_I2C=y

# Enable MPU
CONFIG_ARM_MPU=y

# 启用 zmk 蓝牙功能，这是核心功能，必须开启
CONFIG_ZMK_BLE=y

# board板没有 DCDC 电感元件，则需要删除 Kconfig 文件并注释掉以下这行
# 后期如果修改电路，启用 DCDC 电源，则可以启用这个设置
#CONFIG_BOARD_ENABLE_DCDC=n

# 硬件设定为外围设备，键盘对于主机是外围设置，这是必选项
CONFIG_BT_PERIPHERAL=y

# 设备名称
#CONFIG_BT_DEVICE_NAME="TouchCon"
CONFIG_ZMK_KEYBOARD_NAME="TypeMax"

# 与主机连接后，及时向主机发送 zmk 的状态信息，可以简单理解为更快显示电池电量
CONFIG_BT_GATT_ENFORCE_SUBSCRIPTION=n

# 保存配对信息
CONFIG_BT_SMP=y

# 允许设备请求绑定
CONFIG_BT_BONDABLE=y

# 启用蓝牙配置存储到 Flash
CONFIG_BT_SETTINGS=y	

# 最多连接多少个设备，这里其实只能使用 1
CONFIG_BT_MAX_CONN=1

# 最多保存多少个已配对设备，超过会覆盖最老的。这里使用 ← 、↓ 、→ 作为切换槽位的按键,这里的数量会影响电量功耗
CONFIG_BT_MAX_PAIRED=3





#### 电池电量管理相关 #######

# 启用 ADC
CONFIG_ADC=y

# 启用电池服务 (BLE)
CONFIG_BT_BAS=y
CONFIG_ZMK_BATTERY_REPORTING=y

# 设置电量报告间隔为 120 秒 (2 分钟)
CONFIG_ZMK_BATTERY_REPORT_INTERVAL=120

# 进入深度睡眠模式之后，关闭I2C、SPI、UART等接口用于省电
# 如果后续的XW12A芯片无法正常工作，可以尝试停用该功能
CONFIG_PM_DEVICE=y

# 进入空间模式的等待时间阀值，这里是 30 秒。深度睡眠
CONFIG_ZMK_IDLE_TIMEOUT=30000

# 启用深度睡眠功能
#CONFIG_ZMK_SLEEP=y

# 进入深度睡眠模式的等待时间阀值，这里是 15分钟
#CONFIG_ZMK_IDLE_SLEEP_TIMEOUT=60000






# 具体作用我也不知道，但启用它们之后，才能实现 zmk 键盘断电再通电之后直接连接主机
#CONFIG_MPU_ALLOW_FLASH_WRITE=y
#CONFIG_NVS=y
#CONFIG_SETTINGS_NVS=y
#CONFIG_FLASH=y
#CONFIG_FLASH_PAGE_LAYOUT=y
#CONFIG_FLASH_MAP=y
```
